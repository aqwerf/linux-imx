## drivers/video/mxs/Kconfig
```kconfig
config FB_MXS
	tristate "MXS Framebuffer driver"
	depends on FB && ARCH_MXS
	select FB_CFB_FILLRECT
	select FB_CFB_COPYAREA
	select FB_CFB_IMAGEBLIT
	default y
	---help---
	  Say Y here to enable support for the framebuffer driver for the
	  Freescale MXS Board.

config FB_MXS_LCD_43WVF1G
	depends on FB_MXS
	tristate "SEIKO 4.3' LCD WVGA(800x480) PANEL"
	default y if ARCH_MX28

config FB_MXS_LCD_LMS430
	depends on FB_MXS
	bool "LMS430"
	default n if ARCH_MX23
	---help---
	  Use LMS430 dotclock LCD panel for MXS

config FB_MXS_LCD_ILI9225B
	depends on FB_MXS
	bool "ili9225b"
	default n if ARCH_MX23
	---help---
	  a-Si TFT LCD Driver 176RGBx220 Resolution and 262K color

config FB_MXS_LCD_ST7789S
	depends on FB_MXS
	bool "ST7789S"
	default y if ARCH_MX23
	---help---
	  240RGB x 320 dot 262K Color with Frame Memory
	  Single-Chip TFT Controller/Driver.
	  It is default LCD driver of ICW-1000.

config FB_MXS_TVENC
	depends on ARCH_MXS
	bool "TVENC"
	---help---
	  Use TVOUT encoder for MXS
```
